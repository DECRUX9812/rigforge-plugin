/* Mobile manipulator · 419mm reach on a 130mm 4WD base — ESP32-S3 DevKitC-1
 * Generated by Rigforge: mobile manipulator, 6 arm servos on a
 * PCA9685 + 4 driven wheels. One pack, one loop, one arbiter.
 */
#include <Wire.h>
#include <Adafruit_PWMServoDriver.h>

Adafruit_PWMServoDriver pwm = Adafruit_PWMServoDriver(0x40);

// ── drive ──────────────────────────────────────────────────────────────────
// Pin numbers come from the analysis pass — the PINS tab and this file cannot drift.
const uint8_t PWM_L = 1, IN1_L = 2, IN2_L = 10;
const uint8_t PWM_R = 15, IN1_R = 16, IN2_R = 17;
const float   TRACK = 0.312;
const float   VMAX  = 1.21;

// ── arm ────────────────────────────────────────────────────────────────────
const uint8_t JOINTS = 6;
const int16_t LIMITS[][2] = { {-160, 160}, {-80, 80}, {-135, 135}, {-100, 100}, {-180, 180}, {-90, 90} };
int16_t target[6] = {0};
int16_t current[6] = {0};

float speedNow = 0.0f;

void writeJoint(uint8_t i, int16_t deg) {
  uint16_t us = 500 + (uint32_t)((deg + 180) * 2000) / 360;
  pwm.setPWM(i, 0, (uint16_t)((us / 20000.0) * 4096));
}

void setMotor(uint8_t ch, uint8_t in1, uint8_t in2, float cmd) {
  cmd = constrain(cmd, -1.0f, 1.0f);
  digitalWrite(in1, cmd > 0.02f);
  digitalWrite(in2, cmd < -0.02f);
  ledcWrite(ch, (uint8_t)(fabsf(cmd) * 255));
  speedNow = fabsf(cmd) * VMAX;
}

void drive(float v, float w) {
  setMotor(0, IN1_L, IN2_L, (v - w * TRACK / 2) / VMAX);
  setMotor(1, IN1_R, IN2_R, (v + w * TRACK / 2) / VMAX);
}

void stop() { setMotor(0, IN1_L, IN2_L, 0); setMotor(1, IN1_R, IN2_R, 0); }

void setup() {
  Serial.begin(115200);
  Wire.begin(8, 9);
  pwm.begin();
  pwm.setPWMFreq(50);
  ledcAttach(PWM_L, 20000, 8);
  ledcAttach(PWM_R, 20000, 8);
  pinMode(IN1_L, OUTPUT); pinMode(IN2_L, OUTPUT);
  pinMode(IN1_R, OUTPUT); pinMode(IN2_R, OUTPUT);
  stop();
  for (uint8_t i = 0; i < JOINTS; i++) writeJoint(i, 0);
  Serial.println("Mobile manipulator · 419mm reach on a 130mm 4WD base ready — 'D v w' to drive, 'J i deg' to pose, 'S' to stop");
}

void loop() {
  // The arbiter: reaching while moving is what tips this machine over. Below
  // 0.25 VMAX the arm is free, above it the arm is held and targets are refused.
  static uint32_t lastCmd = 0;
  if (Serial.available()) {
    char c = Serial.read();
    if (c == 'D' || c == 'd') {
      float v = Serial.parseFloat(), w = Serial.parseFloat();
      drive(v, w);
      lastCmd = millis();
    } else if (c == 'J' || c == 'j') {
      int idx = Serial.parseInt(), deg = Serial.parseInt();
      if (speedNow > 0.25f * VMAX) {
        Serial.println("refused: arm locked while driving");
      } else if (idx >= 0 && idx < JOINTS) {
        target[idx] = constrain(deg, LIMITS[idx][0], LIMITS[idx][1]);
      }
    } else if (c == 'S' || c == 's') {
      stop();
      for (uint8_t i = 0; i < JOINTS; i++) target[i] = current[i];
    }
  }
  if (millis() - lastCmd > 800) stop();   // lost client = stop, never wander

  for (uint8_t i = 0; i < JOINTS; i++) {
    if (current[i] == target[i]) continue;
    current[i] += (target[i] > current[i]) ? 1 : -1;
    writeJoint(i, current[i]);
  }
  delay(8);
}