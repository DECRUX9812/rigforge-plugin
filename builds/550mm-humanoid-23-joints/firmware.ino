/* 550mm humanoid · 23 joints — ESP32-S3 DevKitC-1
 * Generated by Rigforge. 23 serial-bus joints on two TTL buses.
 *
 * THIS IS A STAND-AND-HOLD CONTROLLER. It does not walk. A biped cannot be made
 * stable by geometry — it needs a balance loop reading the IMU at 200Hz and
 * commanding hips/ankles every cycle. That is the next project, and this file is
 * the honest starting point for it.
 */
#include <SCServo.h>
#include <Wire.h>

SMS_STS st;                       // legs: bus 0
SMS_STS upper;                    // waist + arms + head: bus 1

// Servo IDs are per-bus, so the same ID can exist on each bus:
// legs  ID  1: Left hip yaw
// legs  ID  2: Left hip roll
// legs  ID  3: Left hip pitch
// legs  ID  4: Left knee
// legs  ID  5: Left ankle pitch
// legs  ID  6: Left ankle roll
// legs  ID  7: Right hip yaw
// legs  ID  8: Right hip roll
// legs  ID  9: Right hip pitch
// legs  ID 10: Right knee
// legs  ID 11: Right ankle pitch
// legs  ID 12: Right ankle roll
// upper ID  1: Waist yaw
// upper ID  2: Head pan
// upper ID  3: Head tilt
// upper ID  4: Left shoulder roll
// upper ID  5: Left shoulder pitch
// upper ID  6: Left elbow
// upper ID  7: Left wrist
// upper ID  8: Right shoulder roll
// upper ID  9: Right shoulder pitch
// upper ID 10: Right elbow
// upper ID 11: Right wrist
const long BAUDRATE = 1000000;

void setupBuses() {
  // UART1 = legs, UART2 = arms + head. UART0 stays the console.
  Serial1.begin(BAUDRATE, SERIAL_8N1, 18, 17);
  st.pSerial = &Serial1;
  Serial2.begin(BAUDRATE, SERIAL_8N1, 48, 47);
  upper.pSerial = &Serial2;
}

void standPose() {
  // Every joint to its centre with a slow, low-torque-limit move: on first power
  // up you do NOT want 23 servos snapping to position with the robot upright.
  st.WritePosEx(1, 2048, 120, 30);
  st.WritePosEx(2, 2048, 120, 30);
  st.WritePosEx(3, 2048, 120, 30);
  st.WritePosEx(4, 2048, 120, 30);
  st.WritePosEx(5, 2048, 120, 30);
  st.WritePosEx(6, 2048, 120, 30);
  st.WritePosEx(7, 2048, 120, 30);
  st.WritePosEx(8, 2048, 120, 30);
  st.WritePosEx(9, 2048, 120, 30);
  st.WritePosEx(10, 2048, 120, 30);
  st.WritePosEx(11, 2048, 120, 30);
  st.WritePosEx(12, 2048, 120, 30);
  upper.WritePosEx(1, 2048, 120, 30);
  upper.WritePosEx(2, 2048, 120, 30);
  upper.WritePosEx(3, 2048, 120, 30);
  upper.WritePosEx(4, 2048, 120, 30);
  upper.WritePosEx(5, 2048, 120, 30);
  upper.WritePosEx(6, 2048, 120, 30);
  upper.WritePosEx(7, 2048, 120, 30);
  upper.WritePosEx(8, 2048, 120, 30);
  upper.WritePosEx(9, 2048, 120, 30);
  upper.WritePosEx(10, 2048, 120, 30);
  upper.WritePosEx(11, 2048, 120, 30);
  delay(1200);
}

void holdStand() {
  // Torque on, position held. A real controller replaces this with a balance loop.
  for (int id = 1; id <= 12; id++) st.EnableTorque(id, 1);
  for (int id = 1; id <= 11; id++) upper.EnableTorque(id, 1);
}

void report() {
  // A joint pinned at high load is a servo about to strip a gear.
  for (int id = 1; id <= 12; id++)
    Serial.printf("leg %02d pos=%4d load=%4d\n", id, st.ReadPos(id), st.ReadLoad(id));
  for (int id = 1; id <= 11; id++)
    Serial.printf("up  %02d pos=%4d load=%4d\n", id, upper.ReadPos(id), upper.ReadLoad(id));
}

void setup() {
  Serial.begin(115200);
  setupBuses();
  standPose();
  holdStand();
  Serial.println("550mm humanoid · 23 joints: standing. Balance loop not implemented — see the header.");
}

void loop() {
  // No gait. Read the IMU, watch the joint loads, and stop if anything is
  // fighting: a joint pinned at high load is a servo about to strip a gear.
  static uint32_t last = 0;
  if (millis() - last > 250) {
    last = millis();
    report();
  }
}